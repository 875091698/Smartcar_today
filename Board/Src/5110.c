
#include  "common.h"
#include  "camera.h"
#include  "5110.h"



uint8 font6x8[][6] =                // 字符字库：6个数据组成一个字符
{
    { 0x00, 0x00, 0x00, 0x00, 0x00, 0x00 },   // sp
    { 0x00, 0x00, 0x00, 0x2f, 0x00, 0x00 },   // !
    { 0x00, 0x00, 0x07, 0x00, 0x07, 0x00 },   // "
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    { 0x14, 0x14, 0x14, 0x14, 0x14, 0x14 }    // horiz lines
};

// 5110满屏显示数组，以下数据为一副开机图画
uint8 lcd_image[12][42]={
{0x00,0x00,0x00,0x00,0x00,0x00,0x00,0x60,0x40,0x40,0x40,0x40,0x60,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0x00,0x00},
{0x00,0x00,0x00,0x00,0x00,0x00,0x00,0x00,0x00,0x00,0x00,0x00,0x00,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0x00,0x00},
{0x00,0x00,0x00,0x00,0x00,0x00,0x00,0x00,0x00,0x00,0x00,0x00,0x00,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0x00,0x00},
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{0x00,0x00,0x00,0x00,0x00,0x00,0x00,0x00,0x00,0x01,0x03,0x03,0x03,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0x00,0x00}
};


//-------------------------------------------------------------------------*
//函数名: delay                                                 *
//功  能: 通用延时函数                                             * 
//参  数: ns        						   *	
//返  回: 无                                                               *
//说  明: 用于通用延时不定延时时间 大概为10ns*2*ns                                             *
//-------------------------------------------------------------------------*
void del(u32 ns)
{
    while(ns--);  
}

void lcd_write_byte(u8 dat,u8 command)       // 写入字节，common表示数据/命令
{
    u8 i;
    
    CE_0;
    
    if(command == 0)
    {
        DC_0;
    }
    else
    {
        DC_1;
    }
    
    for(i=0;i<8;i++)
    {
        if(dat&0x80)
        {
            SDIN_1;
        }
        else
        {
            SDIN_0;
        }
        
        SCLK_0;
        
        dat = dat << 1;
        
        SCLK_1;
    }
    
    CE_1;
}


void lcd_set_XY(u8 X,u8 Y)              // 写入位置
{
    lcd_write_byte(0x40 | Y, 0);
    lcd_write_byte(0x80 | X, 0);
}


void lcd_clear()                // 清屏函数
{
    u16 i;
    
    lcd_write_byte(0x0c, 0);
    lcd_write_byte(0x80, 0);
    
    for(i=0; i<504; i++)        // 6*84 == 504
    {
        lcd_write_byte(0, 1);
    }
}

void lcd_clear_line()
{
    u8 i;
    
    lcd_write_byte(0x0c, 0);
    lcd_set_XY(0,9);
    for(i=0;i<84;i++)   lcd_write_byte(0, 1);
    
    lcd_set_XY(0,27);
    for(i=0;i<84;i++)   lcd_write_byte(0, 1);     
}


void lcd_write_image(void)                      // 画图函数
{
    u8 i,j;
    
    lcd_set_XY(0,0);                            // 从(0,0)点开始画
    for(i=0;i<12;i++)
    {
        for(j=0;j<42;j++)
        {
            lcd_write_byte(lcd_image[i][j],1);                   // 1为写数据
        }
    }
}

void lcd_init()                         //LCD初始化
{
    gpio_init(CE,GPO,1);         //端口设置为输出
    gpio_init(SCLK,GPO,1);
    gpio_init(SDIN,GPO,1);
    gpio_init(RST,GPO,1);
    gpio_init(DC,GPO,1);
    

    // 产生一个让lcd_复位的低电平脉冲
    RST_0;
    del(200);
    RST_1;
    
    
    CE_0;           // 关闭lcd
    del(200);
    CE_1;           // 使能lcd

    
    lcd_write_byte(0x21,0);	// 使用扩展命令设置lcd_模式
    lcd_write_byte(0xc8,0);	// 设置偏置电压
    lcd_write_byte(0x06,0);	// 温度校正
    lcd_write_byte(0x13,0);	// 1:48
    lcd_write_byte(0x20,0);	// 使用基本命令
    lcd_clear();	            // 清屏
    lcd_write_byte(0x0c,0);	// 设定显示模式，正常显示
    lcd_set_XY(0,0);  
}


/*****以下部分为5110函数************************************************/

void lcd_write_char(u8 c)       // 字符显示
{
    u8 i;
    
    c -= 32;
    
    for(i=0;i<6;i++)            // 显示一个字符
    {
        lcd_write_byte(font6x8[c][i], 1);
    }
}


void lcd_write_char2(u8 X, u8 Y,u8 c)   // 在特定位置显示字符
{
    lcd_set_XY(X,Y);
    lcd_write_char(c);
}



void lcd_write_str(u8 X, u8 Y,u8 *s)    // 在特定位置显示字符串
{
    lcd_set_XY(X,Y);
    while(*s)
    {
        lcd_write_char(*s);
        s++;
    }
}



void lcd_write_num (u8 X,u8 Y,u16 number)   // 在特定位置显示一个数字
{
    lcd_set_XY(X,Y);
    lcd_write_char2(X,Y,number/100+'0');            // 万
    lcd_write_char2(X+6,Y,number%100/10+'0');        // 千
    lcd_write_char2(X+12,Y,'.');
    lcd_write_char2(X+18,Y,number%10+'0');           // 百
}

void lcd_write_num2 (u8 X,u8 Y,u16 number)   // 在特定位置显示一个数字
{
    lcd_set_XY(X,Y);
    lcd_write_char2(X,Y,number/100+'0');            // 万
    lcd_write_char2(X+6,Y,number%100/10+'0');        // 千
    lcd_write_char2(X+12,Y,number%10+'0');           // 百
}




//****************  智能车5110显示  ******************//
extern u8 image_buf[CAMERA_H][ CAMERA_W];
// extern u8 camera_line_mid[CAMERA_H];  
extern s16 line_mid[CAMERA_H];  //记住教训啊，声明出错了，笨死了
//用来规定显示那一行的
u8 shou_line[48]={    
3,5,7,9,11,13,15,17,

19,21,23,27,29,33,35,37,
41,43,45,47,51,53,55,57,
61,63,65,67,71,73,75,77,
81,83,85,87,91,93,97,99,

103,105,107,109,113,115,117,119
};

u8 camera_line_mid_demo[CAMERA_H]={
151,151,151,151,151,151,151,151,151,151,151,151,151,151,151,151,151,151,151,151,
30,30,30,30,30,30,30,30,30,30,30,30,30,30,30,30,30,30,30,30,
80,80,80,80,80,80,80,80,80,80,80,80,80,80,80,80,80,80,80,80,
149,149,149,149,149,149,149,149,149,149,149,149,149,149,149,149,149,149,149,149,
120,120,120,120,120,120,120,120,120,120,120,120,120,120,120,120,120,120,120,120,
150,150,150,150,150,150,150,150,150,150,150,150,150,150,150,150,150,150,150,150,
};

void car_show()
{
    u8 i,j,k;
    u32 m;
//  float n;
    u8 dat=0;   
    
    
    for(i=0;i<6;i++)
    {
         for(j=0;j<2;j+=1)
        {  
                dat=0xaa;
                lcd_write_byte(dat,1);                
        }
        for(j=2;j<82;j++)
        {
                for(k=0;k<8;k++)
                {
                    dat>>=1;
                    m=image_buf[(shou_line[i*8+k])][(j-2)*2+1];
                    if(m==0x01)
                        dat|=0x80;
    
//                    n=line_mid[(shou_line[i*8+k])];    //显示中线 
//                    if( ((u16)n == ((j-2)*2+1)) || ((u16)n == ((j-2)*2)) )   //  ||
//                    {
//                        dat|=0x80;
//                    }
                }
                lcd_write_byte(dat,1);
                dat=0;                                 
        }
        for(j=82;j<84;j+=1)
        {  
                dat=0xaa;
                lcd_write_byte(dat,1);                
        }
        
    }                        
}


//开开
void Car_show_handstand(void)
{
    u8 i,j,k;
    u32 m;
    s16 n;
    u8 dat=0;   
    
 //  lcd_clear_line();  //浪费时间的清屏
     lcd_set_XY(0,0);
    
    for(i=0;i<6;i++)
    {
         for(j=0;j<2;j+=1)
        {  
                dat=0xaa;
                lcd_write_byte(dat,1);                
        }
        for(j=2;j<82;j++)
        {
                for(k=0;k<8;k++)
                {
                    dat>>=1;
                    m=image_buf[CAMERA_H-(shou_line[i*8+k])-1][CAMERA_W-((j-2)*2+1)];
                    if(m==0x01)
                    {
                        dat|=0x80;
                    }
                    
//                    n = (s16)line_mid[CAMERA_H-(shou_line[i*8+k])-1]; //显示中线 
//                    if( (n == CAMERA_W-((j-2)*2)) || (n == CAMERA_W-((j-2)*2+1)) )  // 
//                    {                                                                    //
//                         dat|=0x80;                                                     //
//                    }                                                             //
                }                                                               
                lcd_write_byte(dat,1);
                dat=0;                                 
        }
        for(j=82;j<84;j+=1)
        {  
                dat=0xaa;
                lcd_write_byte(dat,1);                
        }
        
    }  
    
}
